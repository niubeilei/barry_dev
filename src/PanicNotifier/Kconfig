## src/PanicNotifier/Kconfig
```kconfig
config AOS_PANICNOTIFIER
	tristate "aos panic notifier"
	depends on AOS_CORE
	help
		aos panic notifier
```

## src/RosOS/Kconfig
```kconfig
config AOS_ROS_OS
	tristate "ros os system limit"
	depends on AOS_CORE
	help
		ros os system limit	
```

## src/binlog/Kconfig
```kconfig
config AOS_BINLOG
	tristate "aos binary log facilities"
	depends on AOS_CORE
	help
		aos binary log facilities
```

## src/starvation/Kconfig
```kconfig
config AOS_STARVATION
	tristate "aos starvation manager"
	depends on AOS_CORE
	help
		aos starvation manager
```
